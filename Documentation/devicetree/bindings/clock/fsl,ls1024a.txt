## Documentation/devicetree/bindings/clock/fsl,ls1024a.txt
```
Freescale LS1024A clock bindings
================================

Required properties:

- compatible: Must be "fsl,ls1024a-clkcore", "syscon", "simple-mfd"
- reg: Address and length of device register set
- #clock-cells: Must be <1>
- fsl,ls1024a-bypass-workaround: phandle to the mmio-sram region in IRAM where
                                 the bootloader stored the clock generators
                                 state

Clock generator bypass bug workaround:

The clock generators for each device are affected by a bug, which prevents
reading the value of the bypass bit. To work around it, the bootloader keeps
a mirror of the bypass bits state in IRAM. The clock driver will read thah
state on init to determine the initial state of the clock generators. The
driver will then keep track of that bit state in its own internal structures,
allowing to free the IRAM region for other purposes.

Example:

	clkcore: clkcore@904b0000 {
		compatible = "fsl,ls1024a-clkcore",
			     "syscon", "simple-mfd";
		reg = <0x904b0000 0x400>;
		#clock-cells = <1>;
		fsl,ls1024a-bypass-workaround = <&clk_bypass_bug>;
	};

The node in IRAM looks like this:
	iram: iram@83000000 {
		compatible = "mmio-sram";
		[...]

		clk_bypass_bug: clk_bypass_bug@fc00 {
			reg = <0xfc00 0x400>;
		};
	};
```

## Documentation/devicetree/bindings/i2c/i2c-ls1024a.txt
```
Freescale LS1024A I2C bus controller
====================================

Required properties:
- compatible: should be "fsl,ls1024a-i2c"
- reg: controller registers
- #address-cells: must be <1>
- #size-cells: must be <0>
- interrupts: the interrupt for the I2C controller
- clocks: the reference clock from which the bus clock will be derived
- resets: external I2C controller reset

Optional properties:
- clock-frequency:
    bus clock frequency to operate at, in hertz. This controller supports
    high-speed mode, which allows a bus frequency up to 3400000 Hz. If this
    property is not specified, the maximum frequency for standard I2C,
    100000 Hz is used.

Example:

i2c: i2c@9049c000 {
	compatible = "fsl,ls1024a-i2c";
	#address-cells = <1>;
	#size-cells = <0>;
	reg = <0x9049c000 0x20>;
	interrupts = <GIC_SPI 30 IRQ_TYPE_LEVEL_HIGH>;
	resets = <&clkreset LS1024A_AXI_I2CSPI_RST>;
	clocks = <&clkcore LS1024A_CLK_I2CSPI>;
};
```

## Documentation/devicetree/bindings/pci/fsl,ls1024a.txt
```
* Freescale LS1024A PCIe interface

This PCIe host controller is based on the Synopsys DesignWare PCIe IP
and thus inherits all the common properties defined in designware-pcie.txt.

Required properties:
- compatible: "fsl,ls1024a-pcie"
```

## Documentation/devicetree/bindings/phy/fsl,ls1024a-serdes-phy.txt
```
Device tree bindings documentation for Freescale LS1024A SerDes PHY

Required properties:
- compatible		Must be "fsl,ls1024a-serdes-phy"
- reg			One register specification for the SerDes block
- #address-cells	Must be <1>
- #size-cells		Must be <0>
- resets		Reset bindings for each of the 3 SerDes PHY, ordered
			from 0 to 2.


Subnodes:
Each one of the 3 SerDes instances are subnodes of the parent SerDes node.
Their address is the index of the SerDes PHY (0 through 2). If a subnode is
missing, the corresponding PHY instance is disabled.
A device needing a PHY must use a phandle to the PHY instance subnode instead
of the parent node.

Required properties:
- reg			Must be the SerDes PHY index (0-2)
- #phy-cells		Must be <1>

Optional properties:
- fsl,pcie-external-clk	If present, this property tells the driver to use an
			external 100 MHz clock for the SerDes PHYs used for
			PCIe.
- fsl,sata-external-clk	If present, this property tells the driver to use an
			external 60 MHz clock for the SerDes PHYs used for
			SATA.
- fsl,sata-txlev	If present, override the TX_LEV value for the SerDes
			PHYs used in SATA mode. Range 0-15.
- fsl,pcie-polarity	Takes a value between 0 and 3, which indicates the
			polarity of the differential pairs when used for PCIe
			operation.
			0 is normal polarity, which is the default if this
			property is not present. The values 1 through 3 invert
			polarity of the differential lines in an unspecified
			way (due to a lack of hardware documentation).

Example:

phystat: phystat@90410000 {
	compatible = "fsl,ls1024a-phystat",
		     "syscon";
	reg = <0x90410000 0x100>;
};

serdes@90590000 {
	compatible = "fsl,ls1024a-serdes-phy";
	reg = <0x90590000 0xc000>;
	#address-cells = <1>;
	#size-cells = <0>;
	resets = <&clkreset LS1024A_SERDES_SERDES0_RESET>,
		 <&clkreset LS1024A_SERDES_SERDES1_RESET>,
		 <&clkreset LS1024A_SERDES_SERDES2_RESET>;
	serdes0: serdes0@0 {
		#phy-cells = <1>;
		reg = <0>;
		fsl,pcie-use-external-clk;
	};
	serdes1: serdes1@1 {
		#phy-cells = <1>;
		reg = <1>;
		fsl,pcie-use-external-clk;
		fsl,sata-txlev = <9>;
	};
	serdes2: serdes2@2 {
		#phy-cells = <1>;
		reg = <2>;
	};
};
```

## Documentation/devicetree/bindings/phy/fsl,ls1024a-usb3-phy.txt
```
Freescale LS1024A USB 3.0 PHY

Required properties:
- compatible: "fsl,ls1024a-usb3-phy"
- reg: registers for the PHY device
- #phy-cells: should be 0
- resets: phandles to the "phy" and "utmi" reset controllers
- reset-names: should contain both "phy" and "utmi"

Optional properties:
- clocks: phandle to the system reference clock. Mandatory if
  fsl,use-external-clock is not set. Only 24 MHz and 48 MHz clocks are
  supported.
- fsl,use-external-clock: If an external 100 MHz differential clock is
  provided, use this clock for the PHY.
```

## Documentation/devicetree/bindings/reset/fsl,ls1024a-reset.txt
```
Freescale LS1024A reset controller
==================================

Please also refer to reset.txt in this directory for common reset
controller binding usage.

The reset controller node must be a sub-node of the clock & reset
node on LS1024A SoC.

The reset specifier is the offset in number of bits relative to the
start of the clock and reset IO region.
To set bit b of register at offset o:
	(o << 3) | b
For instance, to reset the PFE using the bit 0 of the PFE_RESET
register at offset 0x108:
	(0x108 << 3) | 0 --> 0x840

Required properties:
- compatible: should be "fsl,ls1024a-reset"
- #reset-cells: must be set to 1

Example:

chip_rst: reset {
	compatible = "fsl,ls1024a-reset";
	#reset-cells = <1>;
};

&pfe {
	resets = <&chip_rst 0x840>;
	reset-names = "pfe";
};
```

## Documentation/devicetree/bindings/watchdog/ls1024a-wdt.txt
```
Freescale LS1024A Watchdog Timer

The watchdog timer node must be a subnode of the timer node.
It will share the same resources.

Required properties:
- compatible: Must be "fsl,ls1024a-wdt"
- fsl,clkcore: phandle to the clkcore node syscon

Optional properties:
- timeout-sec : Contains the default watchdog timeout in seconds

Example:

timer@90450000 {
	compatible = "fsl,ls1024a-timer",
		     "syscon", "simple-mfd";
	reg = <0x90450000 0x100>;
	clocks = <&clkcore LS1024A_CLK_RTC_TIM>;
	resets = <&clkreset LS1024A_AXI_RTC_TIM_RST>;
	watchdog {
		compatible = "fsl,ls1024a-wdt";
		fsl,clkcore = <&clkcore>;
		timeout-sec = <5>;
	};
};
```

## arch/arm/mach-ls1024a/Kconfig
```kconfig
config ARCH_LS1024A
	bool "Freescale LS1024A"
	default n
	depends on ARCH_MULTI_V7
	select ARM_GIC
	select ARM_GLOBAL_TIMER if !SMP
	select HAVE_ARM_TWD if SMP
	select HAVE_ARM_SCU
	select HAVE_SMP
	select CACHE_L2X0
	select ARM_ERRATA_754322
	select ARM_ERRATA_764369 if SMP
	select CLKDEV_LOOKUP
	select COMMON_CLK
	select ARCH_HAS_RESET_CONTROLLER
	select MFD_SYSCON
	select POWER_RESET_SYSCON
	select GPIOLIB
	select MIGHT_HAVE_PCI
	select PINCTRL
	select PINCTRL_LS1024A
	help
	  This enables support for boards built around Freescale's LS1024A SoC
```
